/dts-v1/;
/plugin/;

&base_fpga_region {
	
	#address-cells = <2>;
	#size-cells = <1>;
	ranges = < 0x00000000 0x00000000 0xc0000000 0x20000000>,
	<0x00000001 0x00000020 0xff200020 0x00000010>;
	
	ur_ear_fpga_sim_0: ur_ear_fpga_sim@100000020 {
		compatible = "fe,ur_ear_fpga_sim-1.0", "dev,al-ur_ear_fpga_sim";
		reg = <0x00000001 0x00000020 0x00000010>;
	};
	
	
};
